## main/Kconfig.projbuild
```kconfig
menu "Miele Bridge Configuration"

    config MIELE_CLIENT_ID
        string "Miele API Client ID"
        default "00000000-0000-0000-0000-000000000000"
        help
            The Client ID provided by Miele for the 3rd Party API.

    config MIELE_CLIENT_SECRET
        string "Miele API Client Secret"
        default "your_secret_here"
        help
            The Client Secret provided by Miele for the 3rd Party API.

endmenu
```

## sdkconfig.defaults
```kconfig
# Matter Project Defaults for ESP32-S3

# Flash configuration (8MB based on hardware spec)
CONFIG_ESPTOOLPY_FLASHSIZE_8MB=y
CONFIG_ESPTOOLPY_FLASHSIZE="8MB"

# Enable PSRAM (2MB available)
CONFIG_SPIRAM_BOOT_INIT=y
CONFIG_SPIRAM_TYPE_AUTO=y
CONFIG_SPIRAM_SIZE=-1

# Matter Core Features
CONFIG_BT_ENABLED=y
CONFIG_BT_NIMBLE_ENABLED=y
CONFIG_LWIP_IPV6_AUTOCONFIG=y
CONFIG_ESP_MATTER_MAX_DYNAMIC_ENDPOINT_COUNT=5

# Partition Table
CONFIG_PARTITION_TABLE_CUSTOM=y
CONFIG_PARTITION_TABLE_FILENAME="partitions.csv"
CONFIG_PARTITION_TABLE_OFFSET=0xC000

# Enable Data Model & Generated Templates
CONFIG_ESP_MATTER_ENABLE_DATA_MODEL=y
CONFIG_ESP_MATTER_ENABLE_GENERATED_DATA_MODEL=y

# Enable Clusters for Dishwasher PoC
CONFIG_SUPPORT_OPERATIONAL_STATE_CLUSTER=y
CONFIG_SUPPORT_DISHWASHER_MODE_CLUSTER=y
CONFIG_ESP_MATTER_ENABLE_OPERATIONAL_STATE=y
CONFIG_ESP_MATTER_ENABLE_DISHWASHER_MODE=y

# HTTPS & Certificate Bundle (CRUCIAL for Miele API)
CONFIG_MBEDTLS_CERTIFICATE_BUNDLE=y
CONFIG_MBEDTLS_CERTIFICATE_BUNDLE_DEFAULT_FULL=y

# Debug & Console
CONFIG_ENABLE_CHIP_SHELL=y
CONFIG_ESP_MATTER_CONSOLE_ENABLED=y

# Reliability
CONFIG_MBEDTLS_HKDF_C=y

# HTTP Server Limits for long OAuth URLs
CONFIG_HTTPD_MAX_REQ_HDR_LEN=2048
CONFIG_HTTPD_MAX_URI_LEN=2048

# Stack sizes for Matter & Heavy Tasks
CONFIG_ESP_MAIN_TASK_STACK_SIZE=12288
CONFIG_ESP_SYSTEM_EVENT_TASK_STACK_SIZE=4096
```

## sdkconfig.defaults.local
```kconfig
# Lokale Miele Secrets (Überleben jeden Build-Wipe)
CONFIG_MIELE_CLIENT_ID="0df585cb-2ac3-4bb0-8dd7-5fafe9e392fe"
CONFIG_MIELE_CLIENT_SECRET="60reBsf93NOCiPQiRS1Qxh04skNpoely"
```
