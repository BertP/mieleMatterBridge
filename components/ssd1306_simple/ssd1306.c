#include "ssd1306.h"
#include <string.h>
#include "esp_log.h"

static const char *TAG = "SSD1306";

// Voller ASCII 8x8 Font (32-126)
static const uint8_t font8x8[][8] = {
    {0x00,0x00,0x00,0x00,0x00,0x00,0x00,0x00}, // (space)
    {0x00,0x00,0x5F,0x00,0x00,0x00,0x00,0x00}, // !
    {0x00,0x07,0x00,0x07,0x00,0x00,0x00,0x00}, // "
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    {0x61,0x51,0x49,0x45,0x43,0x00,0x00,0x00}, // Z
};

// SSD1306 Commands
#define COMMAND_MODE 0x00
#define DATA_MODE 0x40

esp_err_t ssd1306_send_cmd(ssd1306_t *dev, uint8_t cmd) {
    i2c_cmd_handle_t link = i2c_cmd_link_create();
    i2c_master_start(link);
    i2c_master_write_byte(link, (dev->i2c_addr << 1) | I2C_MASTER_WRITE, true);
    i2c_master_write_byte(link, COMMAND_MODE, true);
    i2c_master_write_byte(link, cmd, true);
    i2c_master_stop(link);
    esp_err_t err = i2c_master_cmd_begin(dev->i2c_port, link, pdMS_TO_TICKS(100));
    i2c_cmd_link_delete(link);
    return err;
}

esp_err_t ssd1306_send_data(ssd1306_t *dev, const uint8_t *data, size_t len) {
    i2c_cmd_handle_t link = i2c_cmd_link_create();
    i2c_master_start(link);
    i2c_master_write_byte(link, (dev->i2c_addr << 1) | I2C_MASTER_WRITE, true);
    i2c_master_write_byte(link, DATA_MODE, true);
    i2c_master_write(link, (uint8_t*)data, len, true);
    i2c_master_stop(link);
    esp_err_t err = i2c_master_cmd_begin(dev->i2c_port, link, pdMS_TO_TICKS(100));
    i2c_cmd_link_delete(link);
    return err;
}

esp_err_t ssd1306_init(ssd1306_t *dev, i2c_port_t port, uint8_t addr) {
    dev->i2c_port = port;
    dev->i2c_addr = addr;

    uint8_t init_cmds[] = {
        0xAE, // Display Off
        0xD5, 0x80, // Clock Divide Ratio
        0xA8, 0x3F, // Multiplex Ratio
        0xD3, 0x00, // Display Offset
        0x40,       // Start Line
        0x8D, 0x14, // Charge Pump
        0x20, 0x00, // Memory Addressing Mode (Horizontal)
        0xA1,       // Segment Remap
        0xC8,       // COM Output Scan Direction
        0xDA, 0x12, // COM Pins Hardware Config
        0x81, 0xCF, // Contrast Control
        0xD9, 0xF1, // Pre-charge Period
        0xDB, 0x40, // VCOMH Deselect Level
        0xA4,       // Entire Display On (Resume)
        0xA6,       // Normal Display
        0xAF        // Display On
    };

    for(int i=0; i<sizeof(init_cmds); i++) {
        ssd1306_send_cmd(dev, init_cmds[i]);
    }
    
    return ESP_OK;
}

esp_err_t ssd1306_clear(ssd1306_t *dev) {
    for (uint8_t i = 0; i < 8; i++) {
        ssd1306_send_cmd(dev, 0xB0 + i);    // Set Page Address
        ssd1306_send_cmd(dev, 0x00);        // Set Lower Column Address
        ssd1306_send_cmd(dev, 0x10);        // Set Higher Column Address
        
        uint8_t clear_data[128] = {0};
        ssd1306_send_data(dev, clear_data, 128);
    }
    return ESP_OK;
}

esp_err_t ssd1306_draw_string(ssd1306_t *dev, uint8_t x, uint8_t y, const char *str) {
    if (y > 7) return ESP_ERR_INVALID_ARG;
    
    ssd1306_send_cmd(dev, 0xB0 + y);
    ssd1306_send_cmd(dev, x & 0x0F);
    ssd1306_send_cmd(dev, 0x10 | (x >> 4));

    for (int i = 0; i < strlen(str); i++) {
        uint8_t c = str[i];
        if (c < 0x20 || c > 0x7F) c = 0x20;
        
        ssd1306_send_data(dev, font8x8[c-0x20], 8);
    }
    return ESP_OK;
}

esp_err_t ssd1306_draw_bitmap(ssd1306_t *dev, uint8_t x, uint8_t y_page, uint8_t width, uint8_t height, const uint8_t *data) {
    if (y_page > 7) return ESP_ERR_INVALID_ARG;
    
    uint8_t pages = (height + 7) / 8;
    for (uint8_t p = 0; p < pages; p++) {
        if (y_page + p > 7) break;
        ssd1306_send_cmd(dev, 0xB0 + y_page + p);
        ssd1306_send_cmd(dev, x & 0x0F);
        ssd1306_send_cmd(dev, 0x10 | (x >> 4));
        ssd1306_send_data(dev, &data[p * width], width);
    }
    return ESP_OK;
}
